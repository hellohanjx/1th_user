/*******************************************************************************
** 文件名: 		stm32f10x_it.c
** 版本：  		1.0
** 工作环境: 	RealView MDK-ARM 4.20
** 作者: 		吴国炎
** 生成日期: 	2011-04-10
** 功能:		中断源文件
** 相关文件:	无
** 修改日志：	2011-04-10   创建文档
*******************************************************************************/
#include "stm32f10x_it.h"
#include "header.h"
#include <ucos_ii.h>
#include "os_cpu.h"
#include    <cpu.h>
#include    <app_cfg.h>

/*******************************************************************************
  * @函数名称	NMI_Handler
  * @函数说明   不可屏蔽中断发生的中断处理函数
  * @输入参数   无
  * @输出参数   无
  * @返回参数   无
*******************************************************************************/
void NMI_Handler(void)
{
}

/*******************************************************************************
  * @函数名称	HardFault_Handler
  * @函数说明   硬件错误发生的中断处理函数
  * @输入参数   无
  * @输出参数   无
  * @返回参数   无
*******************************************************************************/
void HardFault_Handler(void)
{
    //当硬件错误发生时进入死循环 
	lcd_show_character(&pt_word.warring[8]); 		

    while (1)
    {
    }
}

/*******************************************************************************
  * @函数名称	MemManage_Handler
  * @函数说明   内存管理中断发生的中断处理函数
  * @输入参数   无
  * @输出参数   无
  * @返回参数   无
*******************************************************************************/
void MemManage_Handler(void)
{
    //当内存管理中断发生时进入死循环 
    while (1)
    {
    }
}

/*******************************************************************************
  * @函数名称	BusFault_Handler
  * @函数说明   总线错误发生的中断处理函数
  * @输入参数   无
  * @输出参数   无
  * @返回参数   无
*******************************************************************************/
void BusFault_Handler(void)
{
    //当总线错误发生时进入死循环 
    while (1)
    {
    }
}

/*******************************************************************************
  * @函数名称	UsageFault_Handler
  * @函数说明   Usage 错误错误发生的中断处理函数
  * @输入参数   无
  * @输出参数   无
  * @返回参数   无
*******************************************************************************/
void UsageFault_Handler(void)
{
    //当Usage 错误发生时进入死循环 
    while (1)
    {
    }
}

/*******************************************************************************
  * @函数名称	SVC_Handler
  * @函数说明   SVC调用中断发生的中断处理函数
  * @输入参数   无
  * @输出参数   无
  * @返回参数   无
*******************************************************************************/
void SVC_Handler(void)
{
}

/*******************************************************************************
  * @函数名称	DebugMon_Handler
  * @函数说明   调试监控中断发生的中断处理函数
  * @输入参数   无
  * @输出参数   无
  * @返回参数   无
*******************************************************************************/
void DebugMon_Handler(void)
{
}

/*******************************************************************************
  * @函数名称	SysTick_Handler
  * @函数说明   SysTick中断发生的中断处理函数
  * @输入参数   无
  * @输出参数   无
  * @返回参数   无
*******************************************************************************/
void SysTick_Handler(void)
{
	OS_CPU_SR  cpu_sr;


    OS_ENTER_CRITICAL();  //保存全局中断标志,关总中断/* Tell uC/OS-II that we are starting an ISR*/
    OSIntNesting++;
    OS_EXIT_CRITICAL();	  //恢复全局中断标志

    OSTimeTick();     /* Call uC/OS-II's OSTimeTick(),在os_core.c文件里定义,主要判断延时的任务是否计时到*/

    OSIntExit();  //在os_core.c文件里定义,如果有更高优先级的任务就绪了,则执行一次任务切换  
}
/******************************************************************************/
/*                 STM32F10x 外设 中断 服务函数                               */
/*  增加需要的外设中断函数在下面。中断的函数名字都已经在startup_stm32f10x_xx.s*/
/*  的文件中定义好了，请参照它来写。                                          */
/******************************************************************************/


//用户增加自己的中断服务程序这下面。

/***********************************文件结束***********************************/
